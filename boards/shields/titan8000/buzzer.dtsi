/*
 * Copyright (c) 2025 The ZMK Contributors
 * Copyright (c) 2025 monksoffunk
 *
 * SPDX-License-Identifier: MIT
 */

/ {
    behaviors {
        /omit-if-no-ref/ buzz: buzzer {
            compatible = "zmk,behavior-buzzer";
            #binding-cells = <1>;
        };
    };
};
