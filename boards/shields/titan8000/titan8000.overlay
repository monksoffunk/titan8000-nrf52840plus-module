#include "titan8000.dtsi"

/ {
	chosen {
		zmk,kscan = &kscan0;
		zmk,physical-layout = &titan8000_physical_layout;
	};

	soft_off_wakers {
		compatible = "zmk,soft-off-wakeup-sources";
		wakeup-sources = <&kscan0>;
	};
};