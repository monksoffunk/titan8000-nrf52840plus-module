/*
 * Copyright (c) 2025 The ZMK Contributors
 *
 * SPDX-License-Identifier: MIT
 */

// Disable peripherals that conflict with keyboard matrix pins (D0-D10)
// RP2040 default configuration enables UART0, SPI0, and I2C1
// which use pins P0-P7, conflicting with the charlieplex matrix

&uart0 {
    status = "disabled";
};

&spi0 {
    status = "disabled";
};

&i2c1 {
    status = "disabled";
};
