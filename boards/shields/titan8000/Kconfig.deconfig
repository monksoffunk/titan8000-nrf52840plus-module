## boards/shields/titan8000/Kconfig.deconfig
```kconfig
# Copyright (c) 2021 The ZMK Contributors
# SPDX-License-Identifier: MIT

if SHIELD_TITAN8000

config ZMK_KEYBOARD_NAME
    default "Titan 8000"

config PWM
    default y if TITAN8000_BUZZER

endif
```

## boards/shields/titan8000/Kconfig.shield
```kconfig
config SHIELD_TITAN8000
	def_bool $(shields_list_contains,titan8000)

if SHIELD_TITAN8000

config TITAN8000_BUZZER
	bool "Enable buzzer support for Titan8000"
	depends on BOARD_SEEEDUINO_XIAO_BLE
	select PWM
	select PWM_NRFX
	select NRFX_PWM0
	default y if BOARD_SEEEDUINO_XIAO_BLE
	default n
	help
	  Enable PWM-based buzzer support for Titan8000 keyboard.
	  This requires hardware with PWM capability (e.g., Xiao BLE).

endif
```

## boards/shields/titan8000/boards/seeeduino_xiao_ble.conf
```kconfig
# Bluetooth configuration
CONFIG_ZMK_BLE=y
# CONFIG_BT_CTLR_TX_PWR_PLUS_8=y
CONFIG_ZMK_BLE_EXPERIMENTAL_FEATURES=y

# BLE device name
CONFIG_BT_DEVICE_NAME="Titan8000"

# BLE advertising settings
CONFIG_BT_MAX_CONN=5
CONFIG_BT_MAX_PAIRED=5

# Battery reporting
CONFIG_ZMK_BATTERY_REPORTING=y

# Sleep configuration (deep sleep after 30 minutes)
CONFIG_ZMK_SLEEP=y
CONFIG_ZMK_IDLE_SLEEP_TIMEOUT=1800000

# Enable soft_off s
CONFIG_ZMK_PM_SOFT_OFF=y
CONFIG_PM=y

# Enable buzzer support
CONFIG_TITAN8000_BUZZER=y

# Enable PWM for buzzer
CONFIG_PWM=y
CONFIG_PWM_NRFX=y
CONFIG_NRFX_PWM0=y

# NFC pins setting
CONFIG_NFCT_PINS_AS_GPIOS=y
```

## boards/shields/titan8000/dts/bindings/behaviors/zmk,behavior-buzzer-tog.yaml
```yaml
# Copyright (c) 2025 The ZMK Contributors
# Copyright (c) 2025 monksoffunk
# SPDX-License-Identifier: MIT

description: Toggle buzzer keypress beep on/off

compatible: "zmk,behavior-buzzer-tog"

include: zero_param.yaml
```

## boards/shields/titan8000/dts/bindings/behaviors/zmk,behavior-buzzer.yaml
```yaml
# Copyright (c) 2025 The ZMK Contributors
# Copyright (c) 2025 monksoffunk
# SPDX-License-Identifier: MIT

description: Buzzer Behavior
compatible: "zmk,behavior-buzzer"
include: one_param.yaml
```

## boards/shields/titan8000/dts/bindings/behaviors/zmk,behavior-titan8000-soft-off.yaml
```yaml
# Copyright (c) 2025
# SPDX-License-Identifier: MIT

description: Titan8000 soft-off request behavior

compatible: "zmk,behavior-titan8000-soft-off"

include: zero_param.yaml

properties:
  hold-time-ms:
    type: int
    required: false
    description: Number of milliseconds the behavior must be held before releasing will actually trigger a soft-off.
  split-peripheral-off-on-press:
    type: boolean
    description: When built for a split peripheral, turn off on press, not release
```

## config/Kconfig
```kconfig
# SPDX-License-Identifier: MIT

# Module-side Kconfig to ensure required ZMK support is enabled when using
# the Titan8000 custom kscan compatible.

if KSCAN

DT_COMPAT_TITAN8000_KSCAN_GPIO_CHARLIEPLEX := titan8000,kscan-gpio-charlieplex

config TITAN8000_KSCAN_GPIO_CHARLIEPLEX
    bool
    default $(dt_compat_enabled,$(DT_COMPAT_TITAN8000_KSCAN_GPIO_CHARLIEPLEX))
    select ZMK_KSCAN_GPIO_DRIVER

endif # KSCAN
```
