/*
 * Copyright (c) 2025 The ZMK Contributors
 * Copyright (c) 2025 monksoffunk
 *
 * SPDX-License-Identifier: MIT
 */

/ {
    behaviors {
        /omit-if-no-ref/ buzzer_tog: buzzer_tog {
            compatible = "zmk,behavior-buzzer-tog";
            #binding-cells = <0>;
        };
    };
};
